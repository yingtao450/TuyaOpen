## apps/tuya.ai/your_chat_bot/src/display/Kconfig
```kconfig
if(ENABLE_CHAT_DISPLAY) 
choice 
    prompt "choose display gui"
    default ENABLE_GUI_WECHAT

    config ENABLE_GUI_WECHAT
        bool "WeChat-like chat interface"

    config ENABLE_GUI_CHATBOT
        bool "Chatbot interface"
endchoice

config ENABLE_GUI_STREAM_AI_TEXT
    bool "support streaming display of ai text"
    default n  
     
endif
```

## boards/T5AI/Kconfig
```kconfig
# Ktuyaconf
config PLATFORM_CHOICE
    string
    default "T5AI"

config PLATFORM_T5
    bool
    default y

config OPERATING_SYSTEM
    int
    default 98
    ---help---
        100     /* LINUX */
        98      /* RTOS */

choice
    prompt "Choice a module"

    config MODULE_CHOICE_T5_E1
        bool "T5-E1"
    if (MODULE_CHOICE_T5_E1)
    rsource "./T5-E1/Kconfig"
    endif

    config MODULE_CHOICE_T5_E1_IPEX
        bool "T5-E1_IPEX"
    if (MODULE_CHOICE_T5_E1_IPEX)
    rsource "./T5-E1-IPEX/Kconfig"
    endif

endchoice
```

## boards/T5AI/TUYA_T5AI_BOARD/Kconfig
```kconfig
config CHIP_CHOICE
    string
    default "T5AI"

config BOARD_CHOICE
    string
    default "TUYA_T5AI_BOARD"

config BOARD_CONFIG
    bool
    default y
    select ENABLE_AUDIO_CODECS
    select ENABLE_LED
    select ENABLE_BUTTON

config ENABLE_AUDIO_AEC
    bool "audio support AEC"
    default n
```

## src/tuya_audio_service/Kconfig
```kconfig
config ENABLE_AUDIO_SERVICE
    bool "configure tuya audio service"
    select ENABLE_LIB_PROTOBUF_C
    select ENABLE_VOICE_PROTOCOL_CONFIG
    select ENABLE_SPEAKER_UPLOAD_SERVICE_CONFIG
    select ENABLE_BUILD_SPEEX
    default n

if (ENABLE_AUDIO_SERVICE)
    rsource "tuya_voice_protocol/Kconfig"
    rsource "speaker_upload/Kconfig"
    rsource "speex/Kconfig"
endif
```

## src/tuya_audio_service/speaker_upload/Kconfig
```kconfig
menuconfig ENABLE_SPEAKER_UPLOAD_SERVICE_CONFIG
    bool "speaker upload service configuration"
    default y

    if (ENABLE_SPEAKER_UPLOAD_SERVICE_CONFIG)
        config ENABLE_SPEAKER_UPLOAD_SERVICE_OPUS_ENCODE
        bool "enable opus media format encode. depend opus opensource package"
        default y
        ### depend see opus -> ENABLE_BUILD_OPUS ###

        config ENABLE_SPEAKER_UPLOAD_SERVICE_SPEEX_ENCODE
        bool "enable speex media format encode. depend speex opensource package"
        default y
        ### depend see speex -> ENABLE_BUILD_SPEEX ###

        config ENABLE_SPEAKER_UPLOAD_SERVICE_WAV_PCM_ENCODE
        bool "enable wav/pcm media format encode"
        default y
    endif # ENABLE_SPEAKER_UPLOAD_SERVICE_CONFIG
```

## src/tuya_audio_service/tuya_voice_protocol/Kconfig
```kconfig
menuconfig ENABLE_VOICE_PROTOCOL_CONFIG
    bool "enable voice_protocol_conifg"
    default y
    if (ENABLE_VOICE_PROTOCOL_CONFIG)
        config ENABLE_VOICE_PROTOCOL_HTTP
            bool "enable voice http protocol"
            default n
            
        config ENABLE_VOICE_PROTOCOL_STREAM_GW
            bool "enable voice stream_gw protocol"
            default y
            if (ENABLE_VOICE_PROTOCOL_STREAM_GW)
                config ENABLE_VOICE_STREAM_GW_MID_PROTOBUF
                    bool "enable voice stream_gw mid_protobuf"
                    default y

                config ENABLE_VOICE_STREAM_GW_MID_WEBSOCKET_CLIENT
                    bool "enable voice stream_gw mid_websocket_client"
                    default y

                config ENABLE_VOICE_TTS_STREAM
                    bool "enable voice tts stream"
                    default y

                config VOICE_PROTOCOL_STREAM_GW_KEEP_ALIVE_TIME
                    int "set websocket gw keep alive time (seconds)"
                    default 15

                config VOICE_PROTOCOL_STREAM_GW_HANDSHAKE_CONN_TIMEOUT
                    int "set websocket handshake connection timesout (seconds)"
                    default 10

                config VOICE_PROTOCOL_STREAM_GW_HANDSHAKE_RECV_TIMEOUT
                    int "set websocket gw handshake recvice timeout (ms)"
                    default 2000

                config VOICE_PROTOCOL_STREAM_GW_RECONNECT_WAIT_TIME
                    int "set websocket gw reconnect wait time(ms)"
                    default 2000

            endif
        config ENABLE_AI_SPEAKER
            int "enable AI voice cloud service"
            range 0 1
            default 1

        config ENABLE_TUYA_VOICE_ASAN
            bool "enable asan Compile options"
            default n
    endif
```
